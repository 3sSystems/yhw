## build/conf/bblayers.conf
```bitbake
# POKY_BBLAYERS_CONF_VERSION is increased each time build/conf/bblayers.conf
# changes incompatibly
POKY_BBLAYERS_CONF_VERSION = "2"

BBPATH = "${TOPDIR}"
BBFILES ?= ""

BBLAYERS ?= " \
  /home/oleh/yocto/sources/poky/meta \
  /home/oleh/yocto/sources/poky/meta-poky \
  /home/oleh/yocto/sources/poky/meta-yocto-bsp \
  /home/oleh/yocto/sources/meta-raspberrypi \
  /home/oleh/yocto/sources/meta-openembedded/meta-oe \
  /home/oleh/yocto/sources/meta-openembedded/meta-python \
  /home/oleh/yocto/sources/meta-openembedded/meta-networking \
  /home/oleh/yocto/sources/meta-openembedded/meta-multimedia \
  /home/oleh/yocto/custom/meta-custom \
  "
```
